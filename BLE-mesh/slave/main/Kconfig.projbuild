## BLE-mesh/slave/main/Kconfig.projbuild
```kconfig
menu "Smart IR BLE Mesh slave"

config SMART_IR_IR_TX_GPIO
    int "IR LED transmit GPIO"
    range 0 39
    default 5
    help
        GPIO connected to the IR LED transistor driver. The sample validates
        AC commands but deliberately does not emit a Daikin frame until the
        exact Daikin protocol family is selected.

endmenu
```

## BLE-mesh/slave/sdkconfig.defaults
```kconfig
CONFIG_IDF_TARGET="esp32"
CONFIG_BT_ENABLED=y
CONFIG_BT_GATTS_SEND_SERVICE_CHANGE_MANUAL=y
CONFIG_BT_BTU_TASK_STACK_SIZE=4512
CONFIG_BTDM_CTRL_MODE_BLE_ONLY=y
CONFIG_BTDM_CTRL_MODEM_SLEEP=n
CONFIG_BTDM_SCAN_DUPL_TYPE_DATA_DEVICE=y
CONFIG_BTDM_BLE_MESH_SCAN_DUPL_EN=y
CONFIG_PARTITION_TABLE_SINGLE_APP_LARGE=y
CONFIG_BLE_MESH=y
CONFIG_BLE_MESH_NODE=y
CONFIG_BLE_MESH_PB_GATT=y
CONFIG_BLE_MESH_SETTINGS=y
CONFIG_BLE_MESH_SEQ_STORE_RATE=100
CONFIG_BLE_MESH_TX_SEG_MSG_COUNT=10
CONFIG_BLE_MESH_RX_SEG_MSG_COUNT=10
CONFIG_ESPTOOLPY_MONITOR_BAUD=115200
CONFIG_ESP_CONSOLE_UART_BAUDRATE=115200
```

## P2P-connection/master/diagnostics/wpa2_softap_smoke/main/Kconfig.projbuild
```kconfig
menu "WPA2 SoftAP smoke-test configuration"

config ESP_WIFI_SSID
    string "Wi-Fi SSID"
    default "smart-ir-wpa2-test"

config ESP_WIFI_PASSWORD
    string "Wi-Fi password"
    default "change-me-1234"

config ESP_WIFI_CHANNEL
    int "Wi-Fi channel"
    range 1 13
    default 6

config ESP_MAX_STA_CONN
    int "Maximum station connections"
    range 1 4
    default 4

config ESP_GTK_REKEYING_ENABLE
    bool "Enable GTK rekeying"
    default y

config ESP_GTK_REKEY_INTERVAL
    int "GTK rekey interval"
    depends on ESP_GTK_REKEYING_ENABLE
    range 60 65535
    default 600

endmenu
```

## P2P-connection/master/diagnostics/wpa2_softap_smoke/sdkconfig.defaults
```kconfig
CONFIG_ESPTOOLPY_FLASHSIZE_16MB=y
CONFIG_ESP_WIFI_SOFTAP_SAE_SUPPORT=n
CONFIG_ESP_WIFI_SSID="smart-ir-wpa2-test"
CONFIG_ESP_WIFI_PASSWORD="change-me-1234"
CONFIG_ESP_WIFI_CHANNEL=6
CONFIG_ESP_MAX_STA_CONN=4
```

## P2P-connection/master/main/Kconfig.projbuild
```kconfig
menu "Smart IR master configuration"

config SMART_IR_RGB_LED_GPIO
    int "Addressable RGB LED GPIO"
    range 0 48
    default 48
    help
        ESP32-S3-DevKitC-1 initial revision and most clones use GPIO48.
        Official DevKitC-1 v1.1 uses GPIO38.

config SMART_IR_FACTORY_RESET_GPIO
    int "Factory reset button GPIO"
    range 0 48
    default 2

config SMART_IR_LOG_PROTOCOL_FRAMES
    bool "Log BLE protocol frames"
    default y

config SMART_IR_DIAGNOSTIC_OPEN_AP
    bool "DIAGNOSTIC: run provisioning AP without a password"
    default n
    help
        Removes WPA2 only to isolate SoftAP authentication problems. Do not
        enable in production because Wi-Fi credentials may be submitted over
        an unencrypted local network.

        The normal WPA2 AP uses channel 6 and an 802.11b/g/n HT20 profile.
        This option only removes authentication and limits the AP to one
        client.

config SMART_IR_AP_PASSWORD
    string "Provisioning SoftAP password"
    default "change-me-1234"
    help
        WPA2 password for the provisioning SoftAP. Change this value through
        menuconfig before deploying the firmware.

endmenu
```

## P2P-connection/master/sdkconfig.defaults
```kconfig
CONFIG_ESPTOOLPY_FLASHSIZE_16MB=y
CONFIG_PARTITION_TABLE_CUSTOM=y
CONFIG_PARTITION_TABLE_CUSTOM_FILENAME="partitions.csv"
CONFIG_PARTITION_TABLE_FILENAME="partitions.csv"
CONFIG_BT_ENABLED=y
CONFIG_BT_NIMBLE_ENABLED=y
CONFIG_BT_NIMBLE_ROLE_CENTRAL=y
CONFIG_BT_NIMBLE_ROLE_PERIPHERAL=y
CONFIG_BT_NIMBLE_MAX_CONNECTIONS=2
CONFIG_BT_NIMBLE_GATT_MAX_PROCS=4
CONFIG_BT_NIMBLE_ATT_PREFERRED_MTU=517
CONFIG_BT_NIMBLE_SM_LEGACY=n
CONFIG_BT_NIMBLE_NVS_PERSIST=y
CONFIG_ESP_COREDUMP_ENABLE_TO_FLASH=y
CONFIG_ESP_COREDUMP_DATA_FORMAT_ELF=y
CONFIG_ESP_SYSTEM_PANIC_PRINT_REBOOT=y
CONFIG_SMART_IR_RGB_LED_GPIO=48
CONFIG_SMART_IR_FACTORY_RESET_GPIO=2
CONFIG_SMART_IR_LOG_PROTOCOL_FRAMES=y
```

## P2P-connection/slave/main/Kconfig.projbuild
```kconfig
menu "Smart IR slave configuration"

config SMART_IR_IR_TX_GPIO
    int "IR LED transmit GPIO"
    range 0 39
    default 4
    help
        GPIO connected to the IR LED transistor driver. The Daikin encoder is
        intentionally disabled until the exact protocol variant is selected.

config SMART_IR_TRANSACTION_IDLE_MS
    int "Idle time before deep sleep (ms)"
    range 100 1000
    default 250
    help
        Quiet interval after the last response. A new command restarts it,
        allowing the master to drain its queue before PRE_SLEEP_STATUS.

endmenu
```
